&amba{
                dpu@8f000000 {
                        compatible = "deephi, dpu";
                        interrupt-parent = <&gic>;
                        interrupts = <0x0 0x59 0x1 >;
                        reg = <0x0 0x8f000000 0x0 0x700>;
                        memory = <0x60000000 0x80000000>;
                        core-num = <0x1>;
                };
 };

